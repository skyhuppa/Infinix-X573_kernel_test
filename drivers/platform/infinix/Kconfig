## drivers/platform/infinix/Kconfig
```kconfig
menu "Infinix board selection"

config MACH_INFINIX
	bool "Support for Infinix products"
	depends on ARCH_QCOM
	help
	  Support for Infinix products.

config MACH_INFINIX_MSM8937
	bool "Support for Infinix MSM8937 (Yupik) platform devices."
	depends on ARCH_YUPIK
	select MACH_INFINIX
	help
	  Support for Infinix MSM8937 (Yupik) platform devices.

config MACH_INFINIX_X573
	bool "Support for Infinix Hot S 3 (X573) board"
	select MACH_INFINIX_MSM8937
	help
	  Support for Infinix Hot S 3 (X573) board.

endmenu

comment "Xiaomi Features"

config PERF_HUMANTASK
	bool "enable feature humantask"
	depends on MACH_INFINIX
	help
	  support switch on/off of sched humantask.

config MIMISC_MC
	bool "mi misc memory group"
	depends on MACH_INFINIX && MEMCG
	help
	  Acct ion/gpu misc memory to memory cgroup

config QGKI_SYSTEM
	bool "QGKI config"
	depends on MACH_INFINIX
	help
 	  Some QGKI Stuff by infinixname
```
